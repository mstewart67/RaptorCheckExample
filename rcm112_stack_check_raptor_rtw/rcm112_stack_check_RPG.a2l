/************************************************
* ASAP2 file
* Generated by Raptor 3/27/2024 1:32:01 PM
* New Eagle, LLC 2012
* Machine: NE0163
* User : mstewart
* OS : Microsoft Windows NT 6.2.9200.0
************************************************/ ASAP2_VERSION 1 51
/begin PROJECT rcm112_stack_check_019
/*LongIdentifier (BUILD_UID) */ "cHsniQ4BFkKLIFdBUC42O"
/begin MODULE rcm112_stack_check
/*LongIdentifier (XCPProdID) */ "20037"
/begin IF_DATA XCP
 /begin PROTOCOL_LAYER /* XCP protocol layer version */ 0x100 /* T1 [ms] */ 2000 /* T2 [ms] */ 2000 /* T3 [ms] */ 2000 /* T4 [ms] */ 2000 /* T5 [ms] */ 2000 /* T6 [ms] */ 0050 /* T7 [ms] */ 0050 /* MAX_CTO */ 8 /* MAX_DTO */ 8 /* BYTE_ORDER */ BYTE_ORDER_MSB_FIRST /* ADDRESS_GRANULARITY */ ADDRESS_GRANULARITY_BYTE OPTIONAL_CMD SET_REQUEST OPTIONAL_CMD SET_MTA OPTIONAL_CMD UPLOAD OPTIONAL_CMD BUILD_CHECKSUM OPTIONAL_CMD TRANSPORT_LAYER_CMD OPTIONAL_CMD CLEAR_DAQ_LIST OPTIONAL_CMD SET_DAQ_PTR OPTIONAL_CMD WRITE_DAQ OPTIONAL_CMD SET_DAQ_LIST_MODE OPTIONAL_CMD START_STOP_DAQ_LIST OPTIONAL_CMD START_STOP_SYNCH OPTIONAL_CMD GET_DAQ_CLOCK OPTIONAL_CMD FREE_DAQ OPTIONAL_CMD ALLOC_DAQ OPTIONAL_CMD ALLOC_ODT OPTIONAL_CMD ALLOC_ODT_ENTRY OPTIONAL_CMD GET_SEED OPTIONAL_CMD UNLOCK OPTIONAL_CMD GET_DAQ_RESOLUTION_INFO OPTIONAL_CMD GET_DAQ_PROCESSOR_INFO OPTIONAL_CMD DOWNLOAD OPTIONAL_CMD GET_COMM_MODE_INFO
  /begin COMMUNICATION_MODE_SUPPORTED /begin BLOCK SLAVE MASTER /* MAX_BS */ 0xff /* MIN_ST */ 100 /end BLOCK /end COMMUNICATION_MODE_SUPPORTED
  SEED_AND_KEY_EXTERNAL_FUNCTION "raptor_XCPSecurity.dll" /end PROTOCOL_LAYER
 /begin DAQ /* DAQ_CONFIG_TYPE */ DYNAMIC /* MAX_DAQ */ 5 /* MAX_EVENT_CHANNEL */ 5 /* MIN_DAQ */ 0 /* OPTIMISATION_TYPE */ OPTIMISATION_TYPE_DEFAULT /* ADDRESS_EXTENSION */ ADDRESS_EXTENSION_DAQ /* IDENTIFICATION_FIELD */ IDENTIFICATION_FIELD_TYPE_ABSOLUTE /* GRANULARITY_ODT_ENTRY_SIZE_DAQ */ GRANULARITY_ODT_ENTRY_SIZE_DAQ_BYTE /* MAX_ODT_ENTRY_SIZE_DAQ */ 4 /* OVERLOAD_INDICATION */ NO_OVERLOAD_INDICATION
  /begin TIMESTAMP_SUPPORTED /* TIMESTAMP_TICKS */ 1 /* TIMESTAMP_SIZE */ SIZE_DWORD /* TIMESTAMP_RESOLUTION */ UNIT_1MS /end TIMESTAMP_SUPPORTED
  /begin EVENT "List_5ms" "EV_0" 0 DAQ 20 5 6 0 /end EVENT
  /begin EVENT "List_10ms" "EV_1" 1 DAQ 20 10 6 0 /end EVENT
  /begin EVENT "List_100ms" "EV_2" 2 DAQ 20 100 6 0 /end EVENT
  /begin EVENT "List_500ms" "EV_3" 3 DAQ 20 50 7 0 /end EVENT
  /begin EVENT "List_1000ms" "EV_4" 4 DAQ 20 100 7 0 /end EVENT
 /end DAQ
 /begin XCP_ON_CAN /* XCP on CAN 1.0 */ 0x0100 /* auto-detection -- Bit31= 1: EXT */ CAN_ID_BROADCAST 0x100 /* CMD/STIM (master -> slave) -- Bit31= 1: EXT */ CAN_ID_MASTER 0x200 /* RES/ERR/EV/SERV/DAQ (slave -> master) -- Bit31= 1: EXT */ CAN_ID_SLAVE 0x300 /* In Hz */ BAUDRATE 500000 /* Percentage of complete bit time. */ SAMPLE_POINT 75 SAMPLE_RATE SINGLE /* Slots per bit time. */ BTL_CYCLES 0 /* Length of the synch segment. */ SJW 2 /* Sync Edge */ SYNC_EDGE SINGLE /end XCP_ON_CAN
/end IF_DATA
/begin MOD_PAR /* COMMENT */ "" ECU_CALIBRATION_OFFSET 0x00000000 ADDR_EPK 0x01086AE6 EPK "cHsniQ4BFkKLIFdBUC42O"
 /begin MEMORY_SEGMENT APP_CODE "Application Code" CODE FLASH INTERN 0x01044000 0x00039960 -1 -1 -1 -1 -1
  /begin IF_DATA XCP
   /begin SEGMENT 7 0x01 0x00 0x00 0x00 /begin CHECKSUM XCP_CRC_16_CITT /end CHECKSUM /end SEGMENT
  /end IF_DATA
 /end MEMORY_SEGMENT
 /begin MEMORY_SEGMENT EEPROM_CALS "Calibration Space" DATA EEPROM INTERN 0x0107D960 0x0000002C -1 -1 -1 -1 -1
  /begin IF_DATA XCP
   /begin SEGMENT 1 0x01 0x00 0x00 0x00 /begin CHECKSUM XCP_CRC_16_CITT /end CHECKSUM /begin ADDRESS_MAPPING 0x0107D960 0x508084D0 0x0000002C /end ADDRESS_MAPPING /end SEGMENT
  /end IF_DATA
 /end MEMORY_SEGMENT
 /begin MEMORY_SEGMENT ConstFLASH "Const FLASH Space" CODE FLASH INTERN 0x01086A7C 0x0000009C -1 -1 -1 -1 -1
  /begin IF_DATA XCP
   /begin SEGMENT 0 0x01 0x00 0x00 0x00 /begin CHECKSUM XCP_CRC_16_CITT /end CHECKSUM /end SEGMENT
  /end IF_DATA
 /end MEMORY_SEGMENT
 /begin MEMORY_SEGMENT LIB_CODE "Application Code" CODE FLASH INTERN 0x01086B18 0x00000034 -1 -1 -1 -1 -1
  /begin IF_DATA XCP
   /begin SEGMENT 4 0x01 0x00 0x00 0x00 /begin CHECKSUM XCP_CRC_16_CITT /end CHECKSUM /end SEGMENT
  /end IF_DATA
 /end MEMORY_SEGMENT
 /begin MEMORY_SEGMENT InternalRAM "Ram Space" DATA RAM INTERN 0x40070000 0x00020000 -1 -1 -1 -1 -1
  /begin IF_DATA XCP
   /begin SEGMENT 6 0x01 0x00 0x00 0x00 /begin CHECKSUM XCP_CRC_16_CITT /end CHECKSUM /end SEGMENT
  /end IF_DATA
 /end MEMORY_SEGMENT
 /begin MEMORY_SEGMENT MeasurmentRAM "Measurement Space" VARIABLES RAM INTERN 0x50800000 0x00012000 -1 -1 -1 -1 -1
  /begin IF_DATA XCP
   /begin SEGMENT 5 0x01 0x00 0x00 0x00 /begin CHECKSUM XCP_CRC_16_CITT /end CHECKSUM /end SEGMENT
  /end IF_DATA
 /end MEMORY_SEGMENT
 /* 0x01044000 - 0x0107D960 : APP_CODE */ /* 0x0107D960 - 0x0107D98C : EEPROM_CALS */ /* 0x01086A7C - 0x01086B18 : ConstFLASH */ /* 0x01086B18 - 0x01086B4C : LIB_CODE */ /* 0x40070000 - 0x40090000 : InternalRAM */ /* 0x50800000 - 0x50812000 : MeasurmentRAM */ /end MOD_PAR
/begin MOD_COMMON /* COMMENT */ "" BYTE_ORDER MSB_FIRST ALIGNMENT_BYTE 1 ALIGNMENT_FLOAT32_IEEE 1 ALIGNMENT_FLOAT64_IEEE 1 ALIGNMENT_LONG 1 ALIGNMENT_WORD 1 /end MOD_COMMON
/begin RECORD_LAYOUT RECORD_LAYOUT__2 FNC_VALUES 1 FLOAT32_IEEE ROW_DIR DIRECT /end RECORD_LAYOUT
/begin RECORD_LAYOUT RECORD_LAYOUT__3 FNC_VALUES 1 UBYTE ROW_DIR DIRECT /end RECORD_LAYOUT
/begin RECORD_LAYOUT RECORD_LAYOUT__1 FNC_VALUES 1 ULONG ROW_DIR DIRECT /end RECORD_LAYOUT
/begin RECORD_LAYOUT RECORD_LAYOUT__4 FNC_VALUES 1 UWORD ROW_DIR DIRECT /end RECORD_LAYOUT
/begin COMPU_METHOD COMPU_METHOD__8 "" RAT_FUNC "%3.0" "" COEFFS 0 1 0 0 0 1 /end COMPU_METHOD
/begin COMPU_METHOD COMPU_METHOD__2 "" RAT_FUNC "%3.3" "sec" COEFFS 0 1 0 0 0 0.05 /end COMPU_METHOD
/begin COMPU_METHOD COMPU_METHOD__4 "" RAT_FUNC "%5.0" "" COEFFS 0 1 0 0 0 1 /end COMPU_METHOD
/begin COMPU_METHOD COMPU_METHOD__5 "" RAT_FUNC "%5.0" "BITFeild" COEFFS 0 1 0 0 0 1 /end COMPU_METHOD
/begin COMPU_METHOD COMPU_METHOD__1 "" RAT_FUNC "%5.0" "Bool" COEFFS 0 1 0 0 0 1 /end COMPU_METHOD
/begin COMPU_METHOD COMPU_METHOD__7 "" RAT_FUNC "%7.2" "" COEFFS 0 1 0 0 0 1 /end COMPU_METHOD
/begin COMPU_METHOD COMPU_METHOD__3 "" RAT_FUNC "%7.2" "sec" COEFFS 0 1 0 0 0 1 /end COMPU_METHOD
/begin COMPU_METHOD COMPU_METHOD__12 "" TAB_VERB "%3.0" "" COMPU_TAB_REF COMPU_VTAB__5 /end COMPU_METHOD
/begin COMPU_METHOD COMPU_METHOD__10 "" TAB_VERB "%4.0" "" COMPU_TAB_REF COMPU_VTAB__3 /end COMPU_METHOD
/begin COMPU_METHOD COMPU_METHOD__11 "" TAB_VERB "%4.0" "" COMPU_TAB_REF COMPU_VTAB__4 /end COMPU_METHOD
/begin COMPU_METHOD COMPU_METHOD__6 "" TAB_VERB "%5.0" "" COMPU_TAB_REF COMPU_VTAB__1 /end COMPU_METHOD
/begin COMPU_METHOD COMPU_METHOD__9 "" TAB_VERB "%6.0" "" COMPU_TAB_REF COMPU_VTAB__2 /end COMPU_METHOD
/begin COMPU_VTAB COMPU_VTAB__5 "" TAB_VERB 13 0 "Initialization" 1 "Loaded Defaults - Manual" 2 "Loaded Defaults - After Reprogramming" 3 "Loaded Defaults - Incorrect CRC" 4 "Loaded Defaults - Incorrect EE Format" 5 "Loaded Defaults - Error Reading EEPROM" 6 "Loaded Defaults - Failed Driver Initialization" 7 "Loaded Saved Values - After Reprogramming" 8 "Loaded Saved Values - Normal Startup" 9 "Loaded Saved Values - Backup Copy" 10 "Store In Progess" 11 "Store Attempt Failed" 12 "Store Succeeded" /end COMPU_VTAB
/begin COMPU_VTAB COMPU_VTAB__1 "" TAB_VERB 2 0 "False" 1 "True" /end COMPU_VTAB
/begin COMPU_VTAB COMPU_VTAB__2 "" TAB_VERB 2 0 "None" 20037 "Standard" /end COMPU_VTAB
/begin COMPU_VTAB COMPU_VTAB__3 "" TAB_VERB 32 0 "UNKNOWN_RESET" 1 "PROMEMORY" 2 "PROTIME" 3 "PROARRIVAL" 4 "PROLOCKED" 5 "PROEXCEPTION" 6 "PROSTACKFAULT" 17 "ERR_OS_ACCESS" 18 "ERR_OS_CALLEVEL" 19 "ERR_OS_ID" 20 "ERR_OS_LIMIT" 21 "ERR_OS_NOFUNC" 22 "ERR_OS_RESOURCE" 23 "ERR_OS_STATE" 24 "ERR_OS_VALUE" 25 "ERR_OS_SERVICEID" 26 "ERR_OS_ILLEGAL_ADDRESS" 27 "ERR_OS_MISSINGEND" 28 "ERR_OS_DISABLEDINT" 29 "ERR_OS_STACKFAULT" 30 "ERR_OS_CORE" 31 "ERR_OS_SPINLOCK" 32 "ERR_OS_INT_DEADLOCK" 33 "ERR_OS_NEST_DEADLOCK" 34 "ERR_OS_PARAM_POINTER" 35 "ERR_OS_SYS_NO_RESTART" 36 "ERR_OS_SYS_RESTART" 37 "ERR_OS_SYS_OVERRUN" 38 "ERR_OS_SYS_XC_QFULL" 160 "POWER_OFF_RESET" 161 "SOFT_RESET_REQ" 176 "BOOT_REQUEST" /end COMPU_VTAB
/begin COMPU_VTAB COMPU_VTAB__4 "" TAB_VERB 91 0 "BIOS_RTOS_TASK_NEBPS_INIT" 1 "BIOS_RTOS_TASK_NEBPS_1MS" 2 "BIOS_RTOS_TASK_NEBPS_10MS" 3 "BIOS_RTOS_TASK_NEBPS_100MS" 4 "BIOS_RTOS_TASK_NEBPS_IDLE" 5 "BIOS_RTOS_TASK_ASW0_INIT" 6 "BIOS_RTOS_TASK_ASW0_1MS" 7 "BIOS_RTOS_TASK_ASW0_5MS" 8 "BIOS_RTOS_TASK_ASW0_10MS" 9 "BIOS_RTOS_TASK_ASW0_20MS" 10 "BIOS_RTOS_TASK_ASW0_50MS" 11 "BIOS_RTOS_TASK_ASW0_100MS" 12 "BIOS_RTOS_TASK_ASW0_250MS" 13 "BIOS_RTOS_TASK_ASW0_500MS" 14 "BIOS_RTOS_TASK_ASW0_1000MS" 15 "BIOS_RTOS_TASK_ASW0_INT" 16 "BIOS_RTOS_TASK_ASW0_IDLE" 17 "BIOS_RTOS_TASK_ASW1_INIT" 18 "BIOS_RTOS_TASK_ASW1_1MS" 19 "BIOS_RTOS_TASK_ASW1_10MS" 20 "BIOS_RTOS_TASK_ASW1_100MS" 21 "BIOS_RTOS_TASK_ASW1_IDLE" 22 "BIOS_RTOS_ISR_OS_TICK" 23 "BIOS_RTOS_ISR_LONG_TIMER" 24 "BIOS_RTOS_ISR_PWM_IN_00" 25 "BIOS_RTOS_ISR_PWM_IN_01" 26 "BIOS_RTOS_ISR_PWM_IN_02" 27 "BIOS_RTOS_ISR_PWM_IN_03" 28 "BIOS_RTOS_ISR_PWM_IN_04" 29 "BIOS_RTOS_ISR_PWM_IN_05" 30 "BIOS_RTOS_ISR_PWM_IN_06" 31 "BIOS_RTOS_ISR_PWM_IN_07" 32 "BIOS_RTOS_ISR_PWM_IN_08" 33 "BIOS_RTOS_ISR_PWM_IN_09" 34 "BIOS_RTOS_ISR_PWM_IN_10" 35 "BIOS_RTOS_ISR_PWM_IN_11" 36 "BIOS_RTOS_ISR_PWM_IN_12" 37 "BIOS_RTOS_ISR_PWM_IN_13" 38 "BIOS_RTOS_ISR_PWM_IN_14" 39 "BIOS_RTOS_ISR_PWM_IN_15" 40 "BIOS_RTOS_ISR_PWM_IN_16" 41 "BIOS_RTOS_ISR_PWM_IN_17" 42 "BIOS_RTOS_ISR_PWM_IN_18" 43 "BIOS_RTOS_ISR_PWM_IN_19" 44 "BIOS_RTOS_ISR_PWM_IN_20" 45 "BIOS_RTOS_ISR_PWM_IN_21" 46 "BIOS_RTOS_ISR_PWM_IN_22" 47 "BIOS_RTOS_ISR_PWM_IN_23" 48 "BIOS_RTOS_ISR_PWM_IN_24" 49 "BIOS_RTOS_ISR_PWM_IN_25" 50 "BIOS_RTOS_ISR_PWM_IN_26" 51 "BIOS_RTOS_ISR_PWM_IN_27" 52 "BIOS_RTOS_ISR_PWM_IN_28" 53 "BIOS_RTOS_ISR_PWM_IN_29" 54 "BIOS_RTOS_ISR_PWM_IN_30" 55 "BIOS_RTOS_ISR_PWM_IN_31" 56 "BIOS_RTOS_ISR_PWM_IN_32" 57 "BIOS_RTOS_ISR_PWM_IN_33" 58 "BIOS_RTOS_ISR_PWM_IN_34" 59 "BIOS_RTOS_ISR_PWM_IN_35" 60 "BIOS_RTOS_ISR_PWM_IN_36" 61 "BIOS_RTOS_ISR_PWM_IN_37" 62 "BIOS_RTOS_ISR_PWM_IN_38" 63 "BIOS_RTOS_ISR_PWM_IN_39" 64 "BIOS_RTOS_ISR_PWM_IN_40" 65 "BIOS_RTOS_ISR_PWM_IN_41" 66 "BIOS_RTOS_ISR_PWM_IN_42" 67 "BIOS_RTOS_ISR_PWM_IN_43" 68 "BIOS_RTOS_ISR_PWM_IN_44" 69 "BIOS_RTOS_ISR_PWM_IN_45" 70 "BIOS_RTOS_ISR_PWM_IN_46" 71 "BIOS_RTOS_ISR_PWM_IN_47" 72 "BIOS_RTOS_ISR_PWM_IN_CC" 73 "BIOS_RTOS_ISR_DMA_ERROR" 74 "BIOS_RTOS_ISR_SWT0" 75 "BIOS_RTOS_ISR_SWT1" 76 "BIOS_RTOS_ISR_ETH" 77 "BIOS_RTOS_ISR_LIN0_RX" 78 "BIOS_RTOS_ISR_LIN0_TX" 79 "BIOS_RTOS_ISR_LIN0_ERR" 80 "BIOS_RTOS_ISR_LIN1_RX" 81 "BIOS_RTOS_ISR_LIN1_TX" 82 "BIOS_RTOS_ISR_LIN1_ERR" 83 "BIOS_RTOS_ISR_LIN3_RX" 84 "BIOS_RTOS_ISR_LIN3_TX" 85 "BIOS_RTOS_ISR_LIN3_ERR" 86 "BIOS_RTOS_ISR_LIN4_RX" 87 "BIOS_RTOS_ISR_LIN4_TX" 88 "BIOS_RTOS_ISR_LIN4_ERR" 89 "BIOS_RTOS_ISR_FCCU_TO" 90 "BIOS_RTOS_ISR_FCCU_ALARM" /end COMPU_VTAB
/begin MEASUREMENT CANWakeIndicator "" UBYTE COMPU_METHOD__4 0 0 0 1 ECU_ADDRESS 0x50800002 /begin FUNCTION_LIST PowerUp_Down /end FUNCTION_LIST /end MEASUREMENT
/begin MEASUREMENT Counter "" FLOAT32_IEEE COMPU_METHOD__7 0 0 -1E+17 1E+17 ECU_ADDRESS 0x50800020 /begin FUNCTION_LIST Foreground /end FUNCTION_LIST /end MEASUREMENT
/begin MEASUREMENT EEPROM_State "EEPROM State on startup." UBYTE COMPU_METHOD__12 0 0 0 255 ECU_ADDRESS 0x50800030 /begin FUNCTION_LIST System /end FUNCTION_LIST /end MEASUREMENT
/begin MEASUREMENT EthLinkStatus "" UBYTE COMPU_METHOD__4 0 0 0 1 ECU_ADDRESS 0x50800004 /begin FUNCTION_LIST PowerUp_Down /end FUNCTION_LIST /end MEASUREMENT
/begin MEASUREMENT EthWakeIndicator "" UBYTE COMPU_METHOD__4 0 0 0 1 ECU_ADDRESS 0x50800003 /begin FUNCTION_LIST PowerUp_Down /end FUNCTION_LIST /end MEASUREMENT
/begin MEASUREMENT FgndTasksStopped "Boolean indicating foreground tasks stopped" UBYTE COMPU_METHOD__1 0 0 0 1 ECU_ADDRESS 0x50800001 /begin FUNCTION_LIST PowerUp_Down /end FUNCTION_LIST /end MEASUREMENT
/begin MEASUREMENT KeepModuleOn "Boolean indicating module to be kept on" UBYTE COMPU_METHOD__1 0 0 0 1 ECU_ADDRESS 0x50800019 /begin FUNCTION_LIST PowerUp_Down /end FUNCTION_LIST /end MEASUREMENT
/begin MEASUREMENT KeySw_Bgnd "Key switch reading from background task" UBYTE COMPU_METHOD__1 0 0 0 1 ECU_ADDRESS 0x50800018 /begin FUNCTION_LIST PowerUp_Down /end FUNCTION_LIST /end MEASUREMENT
/begin MEASUREMENT LINWakeIndicator "" UBYTE COMPU_METHOD__4 0 0 0 1 ECU_ADDRESS 0x50800005 /begin FUNCTION_LIST PowerUp_Down /end FUNCTION_LIST /end MEASUREMENT
/begin MEASUREMENT MPRD_EN "Enable signal for Main Power Relay Driver." UBYTE COMPU_METHOD__1 0 0 0 1 ECU_ADDRESS 0x5080001A /begin FUNCTION_LIST PowerUp_Down /end FUNCTION_LIST /end MEASUREMENT
/begin MEASUREMENT Reset_History "Reset History." ULONG COMPU_METHOD__10 0 0 0 255 ECU_ADDRESS 0x40076B78 MATRIX_DIM 1 10 1 /begin FUNCTION_LIST Platform /end FUNCTION_LIST /end MEASUREMENT
/begin MEASUREMENT ResetReason "The last reset reason." ULONG COMPU_METHOD__10 0 0 0 255 ECU_ADDRESS 0x40076B70 /begin FUNCTION_LIST Platform /end FUNCTION_LIST /end MEASUREMENT
/begin MEASUREMENT ResetTask "The last reset reason." ULONG COMPU_METHOD__11 0 0 0 255 ECU_ADDRESS 0x40076B74 /begin FUNCTION_LIST Platform /end FUNCTION_LIST /end MEASUREMENT
/begin MEASUREMENT Wake_CAN5_RxCount "" ULONG COMPU_METHOD__4 0 0 0 4294967295 ECU_ADDRESS 0x50800008 /begin FUNCTION_LIST PowerUp_Down /end FUNCTION_LIST /end MEASUREMENT
/begin MEASUREMENT Wake_CAN5_SleepDelayTTmr "time that gets compared to Wake_CAN5_SleepDelayTime" ULONG COMPU_METHOD__2 0 0 0 214748364.75 ECU_ADDRESS 0x5080000C /begin FUNCTION_LIST PowerUp_Down /end FUNCTION_LIST /end MEASUREMENT
/begin MEASUREMENT Wake_ETH_SleepDelayTTmr "time that gets compared to Wake_ETH_SleepDelayTime" ULONG COMPU_METHOD__2 0 0 0 214748364.75 ECU_ADDRESS 0x50800010 /begin FUNCTION_LIST PowerUp_Down /end FUNCTION_LIST /end MEASUREMENT
/begin MEASUREMENT Wake_LIN2_SleepDelayTTmr "time that gets compared to Wake_LIN2_SleepDelayTime" ULONG COMPU_METHOD__2 0 0 0 214748364.75 ECU_ADDRESS 0x50800014 /begin FUNCTION_LIST PowerUp_Down /end FUNCTION_LIST /end MEASUREMENT
/begin MEASUREMENT Wake_Source "Source of the Current Wake." UWORD COMPU_METHOD__5 0 0 0 65535 ECU_ADDRESS 0x5080001C /begin FUNCTION_LIST PowerUp_Down /end FUNCTION_LIST /end MEASUREMENT
/begin CHARACTERISTIC BuildNumber "Model build number." VALUE 0x01086A90 RECORD_LAYOUT__1 0 COMPU_METHOD__8 0 4294967295 READ_ONLY /end CHARACTERISTIC
/begin CHARACTERISTIC BuildUID "Unique build ID for this software." ASCII 0x01086AE6 RECORD_LAYOUT__3 0 COMPU_METHOD__8 0 255 READ_ONLY MATRIX_DIM 21 1 1 /end CHARACTERISTIC
/begin CHARACTERISTIC CalIdTxt "Calibration ID for this Software Package." ASCII 0x01086ACC RECORD_LAYOUT__3 0 COMPU_METHOD__8 0 255 MATRIX_DIM 26 1 1 /end CHARACTERISTIC
/begin CHARACTERISTIC DateStamp "Date and time the model was built." ASCII 0x01086B04 RECORD_LAYOUT__3 0 COMPU_METHOD__8 0 255 READ_ONLY MATRIX_DIM 20 1 1 /end CHARACTERISTIC
/begin CHARACTERISTIC HardwareType "Hardware type for the target." VALUE 0x01086B00 RECORD_LAYOUT__1 0 COMPU_METHOD__8 0 4294967295 READ_ONLY /end CHARACTERISTIC
/begin CHARACTERISTIC IdTableRev "IdTableRev for the model (XCP device ids)." VALUE 0x01086AFC RECORD_LAYOUT__4 0 COMPU_METHOD__8 0 65535 READ_ONLY /end CHARACTERISTIC
/begin CHARACTERISTIC KeySwHiTimeThr "State high time threshold" VALUE 0x0107D970 RECORD_LAYOUT__2 0 COMPU_METHOD__3 -1E+17 1E+17 /begin FUNCTION_LIST PowerUp_Down /end FUNCTION_LIST /end CHARACTERISTIC
/begin CHARACTERISTIC KeySwLoTimeThr "State low time threshold" VALUE 0x0107D974 RECORD_LAYOUT__2 0 COMPU_METHOD__3 -1E+17 1E+17 /begin FUNCTION_LIST PowerUp_Down /end FUNCTION_LIST /end CHARACTERISTIC
/begin CHARACTERISTIC MatlabVersion "Matlab version used for build." ASCII 0x01086A94 RECORD_LAYOUT__3 0 COMPU_METHOD__8 0 255 READ_ONLY MATRIX_DIM 13 1 1 /end CHARACTERISTIC
/begin CHARACTERISTIC ModelName "Name of model" ASCII 0x01086A7C RECORD_LAYOUT__3 0 COMPU_METHOD__8 0 255 READ_ONLY MATRIX_DIM 18 1 1 /end CHARACTERISTIC
/begin CHARACTERISTIC RaptorVersion "Raptor version used for build." ASCII 0x01086AA1 RECORD_LAYOUT__3 0 COMPU_METHOD__8 0 255 READ_ONLY MATRIX_DIM 21 1 1 /end CHARACTERISTIC
/begin CHARACTERISTIC SensorPowerEnable "" VALUE 0x0107D978 RECORD_LAYOUT__3 0 COMPU_METHOD__6 0 1 /begin FUNCTION_LIST Enables /end FUNCTION_LIST /end CHARACTERISTIC
/begin CHARACTERISTIC SwIdTxt "Software name for this build." ASCII 0x01086AB6 RECORD_LAYOUT__3 0 COMPU_METHOD__8 0 255 READ_ONLY MATRIX_DIM 22 1 1 /end CHARACTERISTIC
/begin CHARACTERISTIC Wake_CAN5_SleepDelayTime "make sure this is long enough that we dont trigger a ton of EEPROM writes between messages" VALUE 0x0107D964 RECORD_LAYOUT__1 0 COMPU_METHOD__2 0 214748364.75 /begin FUNCTION_LIST PowerUp_Down /end FUNCTION_LIST /end CHARACTERISTIC
/begin CHARACTERISTIC Wake_ETH_SleepDelayTime "make sure this is long enough that we dont trigger a ton of EEPROM writes between messages" VALUE 0x0107D968 RECORD_LAYOUT__1 0 COMPU_METHOD__2 0 214748364.75 /begin FUNCTION_LIST PowerUp_Down /end FUNCTION_LIST /end CHARACTERISTIC
/begin CHARACTERISTIC Wake_LIN2_SleepDelayTime "make sure this is long enough that we dont trigger a ton of EEPROM writes between messages" VALUE 0x0107D96C RECORD_LAYOUT__1 0 COMPU_METHOD__2 0 214748364.75 /begin FUNCTION_LIST PowerUp_Down /end FUNCTION_LIST /end CHARACTERISTIC
/begin CHARACTERISTIC XCP1__XCP_BC_ID "CAN message ID used to identify XCP targets on the CAN bus. This should be the same for all ECUs on the CAN bus. This is how Raptor-Cal discovers ECUs on the CAN bus." VALUE 0x0107D97C RECORD_LAYOUT__1 0 COMPU_METHOD__4 0 4294967295 /begin FUNCTION_LIST XCP /end FUNCTION_LIST /end CHARACTERISTIC
/begin CHARACTERISTIC XCP1__XCP_RX_ID "CAN message ID that the module will receive CMD and STIM commands from the calibration tool on." VALUE 0x0107D980 RECORD_LAYOUT__1 0 COMPU_METHOD__4 0 4294967295 /begin FUNCTION_LIST XCP /end FUNCTION_LIST /end CHARACTERISTIC
/begin CHARACTERISTIC XCP1__XCP_Security "Calibration to change XCP security, takes effect at next power-up." VALUE 0x0107D988 RECORD_LAYOUT__4 0 COMPU_METHOD__9 0 65535 /begin FUNCTION_LIST XCP /end FUNCTION_LIST /end CHARACTERISTIC
/begin CHARACTERISTIC XCP1__XCP_TX_ID "CAN message ID that the module will send RES, ERR, EV, SERV and DAQ commands to the calibration tool on." VALUE 0x0107D984 RECORD_LAYOUT__1 0 COMPU_METHOD__4 0 4294967295 /begin FUNCTION_LIST XCP /end FUNCTION_LIST /end CHARACTERISTIC
/begin FUNCTION Enables "Enables" /end FUNCTION
/begin FUNCTION rcm112_stack_check "rcm112_stack_check" /begin SUB_FUNCTION Foreground /end SUB_FUNCTION /end FUNCTION
/begin FUNCTION Foreground "Foreground" /end FUNCTION
/begin FUNCTION System "System" /begin SUB_FUNCTION Platform PowerUp_Down XCP /end SUB_FUNCTION /end FUNCTION
/begin FUNCTION Platform "Platform" /end FUNCTION
/begin FUNCTION PowerUp_Down "PowerUp_Down" /end FUNCTION
/begin FUNCTION XCP "XCP" /end FUNCTION
/begin USER_RIGHTS Access1 /begin REF_GROUP GroupAccess1 /end REF_GROUP /end USER_RIGHTS
/begin USER_RIGHTS Access4 /begin REF_GROUP GroupAccess4 /end REF_GROUP /end USER_RIGHTS
/begin GROUP GroupAccess1
 /begin REF_CHARACTERISTIC KeySwHiTimeThr KeySwLoTimeThr SensorPowerEnable XCP1__XCP_BC_ID XCP1__XCP_RX_ID XCP1__XCP_TX_ID ModelName BuildNumber MatlabVersion RaptorVersion SwIdTxt CalIdTxt BuildUID IdTableRev HardwareType DateStamp XCP1__XCP_Security /end REF_CHARACTERISTIC
 /begin REF_MEASUREMENT FgndTasksStopped CANWakeIndicator EthWakeIndicator EthLinkStatus LINWakeIndicator KeySw_Bgnd KeepModuleOn MPRD_EN Wake_Source Reset_History ResetReason ResetTask EEPROM_State /end REF_MEASUREMENT
/end GROUP
/begin GROUP GroupAccess4
 /begin REF_CHARACTERISTIC Wake_CAN5_SleepDelayTime Wake_ETH_SleepDelayTime Wake_LIN2_SleepDelayTime /end REF_CHARACTERISTIC
 /begin REF_MEASUREMENT Wake_CAN5_RxCount Wake_CAN5_SleepDelayTTmr Wake_ETH_SleepDelayTTmr Wake_LIN2_SleepDelayTTmr Counter /end REF_MEASUREMENT
/end GROUP
/end MODULE
/end PROJECT
